## sdkconfig.defaults
```kconfig
# ESP32-S3 N16R8 配置: 16MB Flash + 8MB Octal PSRAM
# 使用 idf.py reconfigure 应用此配置

# Flash 大小: 16MB
CONFIG_ESPTOOLPY_FLASHSIZE_16MB=y
CONFIG_ESPTOOLPY_FLASHSIZE="16MB"

# PSRAM: 8MB Octal (八线 OPI, N16R8 模组)
CONFIG_SPIRAM=y
CONFIG_SPIRAM_MODE_OCT=y

# ULP 协处理器: 启用 RISC-V 模式 (Deep Sleep 电池监控)
CONFIG_ULP_COPROC_ENABLED=y
CONFIG_ULP_COPROC_TYPE_RISCV=y
CONFIG_SPIRAM_SPEED_80M=y
CONFIG_SPIRAM_BOOT_INIT=y
CONFIG_SPIRAM_MALLOC_ALWAYSINTERNAL=16384
CONFIG_SPIRAM_TRY_ALLOCATE_WIFI_LWIP=y
CONFIG_SPIRAM_ALLOW_BSS_SEG_EXTERNAL_MEMORY=y

# 分区表: 使用适合 16MB Flash 的分区表
CONFIG_PARTITION_TABLE_CUSTOM=y
CONFIG_PARTITION_TABLE_CUSTOM_FILENAME="partitions_16mb.csv"

# ============================================================
#  IRAM 优化 (解决 IRAM 100% 占满)
# ============================================================

# 关闭 WiFi 日志 (减少 IRAM 占用)
CONFIG_LOG_DEFAULT_LEVEL_WARN=y
CONFIG_LOG_DEFAULT_LEVEL=2

# 关闭不必要的 WiFi 调试功能
CONFIG_ESP_WIFI_STA_DISCONNECTED_PM_ENABLE=n
CONFIG_ESP_WIFI_SOFTAP_SUPPORT=n

# 优化 FreeRTOS: 不强制将所有任务栈放入 IRAM
CONFIG_FREERTOS_TASK_FUNCTION_WRAPPER=n
CONFIG_FREERTOS_CHECK_STACKOVERFLOW_NONE=y

# 关闭 core dump (释放 IRAM)
CONFIG_ESP_COREDUMP_ENABLE=n

# 关闭不需要的 ADC 调试
CONFIG_ADC_DISABLE_DAC=y

# ============================================================
#  FreeRTOS 系统心跳 1000Hz (1ms 精度, 满足 1000Hz IMU 采样)
# ============================================================
CONFIG_FREERTOS_HZ=1000
```
